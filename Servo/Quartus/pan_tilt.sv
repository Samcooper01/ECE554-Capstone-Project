
//=======================================================
//  This code is generated by Terasic System Builder
//=======================================================

module pan_tilt(

	//////////// CLOCK //////////
	input 		          		CLOCK2_50,
	input 		          		CLOCK3_50,
	input 		          		CLOCK4_50,
	input 		          		CLOCK_50,

	//////////// SEG7 //////////
	output		     [6:0]		HEX0,
	output		     [6:0]		HEX1,
	output		     [6:0]		HEX2,
	output		     [6:0]		HEX3,
	output		     [6:0]		HEX4,
	output		     [6:0]		HEX5,

	//////////// KEY //////////
	input 		     [3:0]		KEY,

	//////////// LED //////////
	output		     [9:0]		LEDR,

	//////////// SW //////////
	input 		     [9:0]		SW,

	//////////// GPIO_0, GPIO_0 connect to GPIO Default //////////
	inout 		    [35:0]		GPIO
);

wire pan_pwm; 
wire tilt_pwm;

logic [7:0]pan_angle;
logic [7:0]tilt_angle;

// press button[0] to generate a low active reset signal
wire rst_n = KEY[0];

assign LEDR[0] = ~rst_n;

assign GPIO[0] = tilt_pwm; 
assign GPIO[1] = pan_pwm;

//=======================================================
//  Structural coding
//=======================================================

// instantiate servo module here
servo SERVO_PAN(
	.clk(CLOCK_50), 
	.rst_n(rst_n),
	.angle(pan_angle), 
	.pwm_pin(pan_pwm)
);

servo SERVO_TILT(
	.clk(CLOCK_50), 
	.rst_n(rst_n),
	.angle(tilt_angle), 
	.pwm_pin(tilt_pwm)
);

always @(*) begin
	if (~KEY[2]) begin 
		pan_angle = pan_angle + 1;
		repeat(500) @(posedge CLOCK_50);
	end
	if (~KEY[3]) begin
		pan_angle = pan_angle - 1;
		repeat(500) @(posedge CLOCK_50);
	end
end

always @(*) begin
	HEX5 = 7'b1000000;
    HEX4 = 7'b1000000; // 0;
    HEX3 = 7'b1000000; // 0; 
    HEX2 = 7'b1000000; // 0; 
    HEX1 = 7'b1000000; // 0; 
    HEX0 = 7'b1000000; // 0
end


endmodule
